#include "ESPboyGfx.h"

// Делаем spr указателем
static TFT_eSprite* spr = nullptr;

// Выделяем собственный буфер для игры, чтобы оригинальная
// логика (Draw.cpp / Mask.cpp) работала в привычном ей формате
uint8_t* gfx_fb = nullptr;

// Таблица компактного шрифта 5x7 ASCII (32-126)
static const uint8_t font5x7[] PROGMEM = {
  0x00, 0x00, 0x00, 0x00, 0x00, // Space
  0x00, 0x00, 0x5F, 0x00, 0x00, // !
  0x00, 0x07, 0x00, 0x07, 0x00, // "
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  0x02, 0x01, 0x02, 0x04, 0x02, // ~
};

void gfx_init_espboy(TFT_eSPI* tft) {
  if (gfx_fb == nullptr) {
    gfx_fb = new uint8_t[8192];
  }
  
  if (spr != nullptr) {
    spr->deleteSprite();
    delete spr;
  }
  spr = new TFT_eSprite(tft);
  spr->setColorDepth(4);
  spr->createSprite(128, 128);
}

void gfx_setPalette(const uint16_t* pal16, uint8_t count) {
  if (spr) {
    spr->createPalette((uint16_t*)pal16, count);
  }
}

void gfx_flush_espboy() {
  if (spr) {
    uint8_t* spr_ptr = (uint8_t*)spr->getPointer();
    if (spr_ptr) {
      // Корректировка порядка полубайтов (Nibble Swap)
      // Игра генерирует графику так, что младший полубайт = левый пиксель.
      // TFT_eSprite ожидает, что старший полубайт = левый пиксель.
      for (int i = 0; i < 8192; i++) {
        uint8_t b = gfx_fb[i];
        spr_ptr[i] = (b << 4) | (b >> 4);
      }
    }
    spr->pushSprite(0, 0);
  }
}

// Формат записи пикселя: младший полубайт для четных X, старший — для нечетных
void gfx_pixel(int x, int y, uint8_t c) {
  if ((unsigned)x >= 128 || (unsigned)y >= 128) return;
  int idx = y * 64 + (x >> 1);
  if (x & 1) gfx_fb[idx] = (gfx_fb[idx] & 0x0F) | (c << 4);
  else       gfx_fb[idx] = (gfx_fb[idx] & 0xF0) | (c & 0x0F);
}

void gfx_hline(int x, int y, int w, uint8_t c) {
  for (int i = 0; i < w; i++) gfx_pixel(x + i, y, c);
}

void gfx_vline(int x, int y, int h, uint8_t c) {
  for (int i = 0; i < h; i++) gfx_pixel(x, y + i, c);
}

void gfx_fillRect(int x, int y, int w, int h, uint8_t c) {
  for (int j = 0; j < h; j++)
    for (int i = 0; i < w; i++)
      gfx_pixel(x + i, y + j, c);
}

void gfx_rect(int x, int y, int w, int h, uint8_t c) {
  gfx_hline(x, y, w, c);
  gfx_hline(x, y + h - 1, w, c);
  gfx_vline(x, y, h, c);
  gfx_vline(x + w - 1, y, h, c);
}

void gfx_line(int x0, int y0, int x1, int y1, uint8_t c) {
  int dx = abs(x1 - x0), sx = x0 < x1 ? 1 : -1;
  int dy = -abs(y1 - y0), sy = y0 < y1 ? 1 : -1;
  int err = dx + dy, e2;
  for (;;) {
    gfx_pixel(x0, y0, c);
    if (x0 == x1 && y0 == y1) break;
    e2 = 2 * err;
    if (e2 >= dy) { err += dy; x0 += sx; }
    if (e2 <= dx) { err += dx; y0 += sy; }
  }
}

void gfx_clear(uint8_t c) {
  uint8_t b = (c & 0x0F) | (c << 4);
  memset(gfx_fb, b, 8192);
}

void gfx_blit(const uint8_t *sprData, int x, int y, uint8_t w, uint8_t h, int8_t trans) {
  uint8_t stride = (w + 1) >> 1;
  for (int j = 0; j < h; j++) {
    int yy = y + j;
    if ((unsigned)yy >= 128) continue;
    const uint8_t *row = sprData + j * stride;
    for (int i = 0; i < w; i++) {
      uint8_t b = pgm_read_byte(&row[i >> 1]); // Безопасное чтение
      uint8_t v = (i & 1) ? (b >> 4) : (b & 0x0F);
      int xx = x + i;
      if (v != (uint8_t)trans && (unsigned)xx < 128) {
        gfx_pixel(xx, yy, v);
      }
    }
  }
}



int gfx_textWidth(const char *str) {
  if (!str) return 0;
  int len = strlen(str);
  return len ? len * 6 - 1 : 0;
}

int gfx_text(int x, int y, const char *str, uint8_t c) {
  if (!str) return x;
  int x0 = x;
  while (*str) {
    char ch = *str++;
    if (ch < 32 || ch > 126) ch = '?';
    uint16_t offset = (ch - 32) * 5;
    for (int col = 0; col < 5; col++) {
      uint8_t bits = pgm_read_byte(&font5x7[offset + col]);
      for (int row = 0; row < 7; row++) {
        if (bits & (1 << row)) {
          gfx_pixel(x + col, y + row, c);
        }
      }
    }
    x += 6;
  }
  return x - x0;
}